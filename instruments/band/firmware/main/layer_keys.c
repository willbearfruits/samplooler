// KEYS: the band's keyboard player. It plays the song's chord, voice-led (each chord takes the inversion nearest
// the last one, so the hands barely move), in one of six sounds, two ways while the layer is live (MODE):
//   COMP    it plays by itself: the chord in a rhythm (PATTERN) on the song's grid. Once it has played a second
//           while live it keeps going when another layer is live (the band's keys player); tap REC mutes it
//   KNOCK   a knock on the box plays the chord; how hard is how loud
// In both, leaning towards the bottom edge lifts the voicing an inversion at a time (the top edge lowers it) and
// leaning right opens the tone (left darkens it). The stick: up is the sustain pedal, down plays short (the
// dampers down), right turns the MOTION up (tremolo, the organ's rotor spinning up), left adds grit.
// REC: hold = record (or add) what it plays to its loop on the song's sixteenths (the first loop on any layer
// sets the song's loop through host_first_loop); tap = mute / unmute. A recorded hit keeps its rhythm, touch and
// inversion, not its notes: it plays whatever chord the song has when it comes round. Loop hits come first;
// COMP fills the steps the loop leaves empty. MIDI notes in play the keys as they are (not recorded).
//
// The sounds (SOUND): PIANO (struck strings: inharmonic partials, the lowest two in pairs that beat, ringing
// longer low than high, a hammer's knock, the damper when the key lifts), E.PIANO (FM tines: the bell of a hard
// hit), ORGAN (drawbars 16' 8' 5 1/3' 4' 2 2/3' 2', key click, the rotor), PAD (slow detuned saws), CLAV (a bright
// pulse that darkens as it dies), VIBES (tuned bars 1 : 4 : 10, the motor's tremolo). Eight voices; the quietest
// one goes (in 3 ms) when a ninth is needed, so a chord rings on under the next.
#include "band.h"
#include "ui.h"
#include "spsc.h"
#include <math.h>
#include <stdlib.h>
#include <stdio.h>
#include <string.h>

// The per-sample loops are marked HOT: in IRAM (with any clone GCC makes of them) and built for speed; -O3's unrolling
// made them twice the size and no faster. What runs once a note, a tick or a frame is COLD: small, in flash unless the
// audio path calls it (band_iram.lf, generated by tools/iram_lf.py, lists those).
#ifdef ESP_PLATFORM
#include "esp_attr.h"
#else
#define IRAM_ATTR
#endif
#define COLD __attribute__((optimize("Os"), noinline))
#define HOT  IRAM_ATTR __attribute__((optimize("O2")))

// ---------------------------------------------------------------- params
enum { K_MODE, K_PAT, K_VOICE, K_OCT, K_SWING, K_HUMAN, K_TOUCH, K_PEDAL,
       K_SOUND, K_TONE, K_REL, K_MOTION, K_DRIVE, K_FX, K_N };
enum { M_COMP, M_KNOCK };
enum { PT_WHOLE, PT_HALF, PT_QUARTERS, PT_OFFBEAT, PT_STABS, PT_ARP, PT_GOSPEL, PT_BOSSA, PT_N };
enum { VC_CLOSE, VC_OPEN, VC_SEVENTHS, VC_SPREAD };
enum { S_PIANO, S_EP, S_ORGAN, S_PAD, S_CLAV, S_VIBES, S_N };
#define P(i) LP(L_KEYS, i)

static const char *const pages[2] = { "KEYS", "KEYS SOUND" };
static const char *const mode_l[] = { "COMP", "KNOCK" };
static const char *const pat_l[PT_N] = { "WHOLE", "HALF", "QUARTERS", "OFFBEAT", "STABS", "ARPEGGIO", "GOSPEL", "BOSSA" };
static const char *const voice_l[] = { "CLOSE", "OPEN", "SEVENTHS", "SPREAD" };
static const char *const off_on[] = { "OFF", "ON" };
static const char *const sound_l[S_N] = { "PIANO", "E.PIANO", "ORGAN", "PAD", "CLAV", "VIBES" };
static const param_t params[K_N] = {
    [K_MODE]   = { "MODE", "kmod", 0, PK_ENUM, 0, 0, 1, 1, M_COMP, "", mode_l, "IT PLAYS, OR YOU KNOCK" },
    [K_PAT]    = { "PATTERN", "kpat", 0, PK_ENUM, 0, 0, PT_N - 1, 1, PT_STABS, "", pat_l, "THE RHYTHM COMP PLAYS" },
    [K_VOICE]  = { "VOICING", "kvoi", 0, PK_ENUM, 0, 0, 3, 1, VC_CLOSE, "", voice_l, "HOW THE CHORD IS SPREAD" },
    [K_OCT]    = { "OCTAVE", "koct", 0, PK_NUM, PF_INT | PF_SIGNED, -1, 1, 1, 0, "", NULL, "THE HANDS UP OR DOWN" },
    [K_SWING]  = { "SWING", "kswg", 0, PK_NUM, PF_INT, 0, 75, 5, 0, "%", NULL, "LATE OFFBEATS" },
    [K_HUMAN]  = { "HUMANIZE", "khum", 0, PK_NUM, PF_INT, 0, 100, 5, 20, "%", NULL, "LOOSER TIME AND TOUCH" },
    [K_TOUCH]  = { "TOUCH", "ktch", 0, PK_NUM, PF_INT, 0, 100, 5, 70, "%", NULL, "HOW HARD COMP PLAYS" },
    [K_PEDAL]  = { "PEDAL", "kped", 0, PK_ENUM, 0, 0, 1, 1, 0, "", off_on, "ON: EVERY NOTE RINGS ON" },
    [K_SOUND]  = { "SOUND", "ksnd", 1, PK_ENUM, 0, 0, S_N - 1, 1, S_EP, "", sound_l, "THE INSTRUMENT ITSELF" },
    [K_TONE]   = { "TONE", "kton", 1, PK_NUM, PF_INT, 0, 100, 5, 60, "%", NULL, "DARK TO BRIGHT" },
    [K_REL]    = { "RELEASE", "krel", 1, PK_NUM, PF_LOG, 0.05f, 4.0f, 1.12f, 0.4f, "s", NULL, "HOW LONG A NOTE STAYS OFF" },
    [K_MOTION] = { "MOTION", "kmot", 1, PK_NUM, PF_INT, 0, 100, 5, 30, "%", NULL, "TREMOLO, THE ORGAN'S ROTOR" },
    [K_DRIVE]  = { "DRIVE", "kdrv", 1, PK_NUM, PF_INT, 0, 100, 5, 10, "%", NULL, "GRIT" },
    [K_FX]     = { "ECHO SEND", "kfx ", 1, PK_NUM, PF_INT, 0, 100, 5, 20, "%", NULL, "INTO THE SHARED ECHO" },
};

// The chord at a frame, if the host can tell (it then knows the bar line before its next tick does); else the
// chord now. See BAND_NOTES.md (requests).
static int degree_at(uint32_t frame) { return host_degree_at(frame); }   // exact on the bar line (band.h)

// ---------------------------------------------------------------- between the tasks
enum { C_ON, C_OFF, C_ALLOFF };
typedef struct { uint8_t kind, note, vel; } cmd_t;                        // UI -> audio: MIDI keys
enum { SRC_LIVE, SRC_COMP, SRC_LOOP, SRC_MIDI };
enum { F_ROLL = 1, F_ACCENT = 2 };
typedef struct { uint32_t frame; uint8_t vel, len, flags, src; int8_t tone, inv; } hit_t;   // audio -> UI: hits, to record
typedef struct { uint8_t note, vel, on; } nev_t;                          // audio -> UI: notes, for MIDI and the scene
SPSC(kcmdq, cmd_t, 32)
SPSC(khitq, hit_t, 32)
SPSC(knevq, nev_t, 128)
static kcmdq_t cmds;
static khitq_t hits;
static knevq_t nevs;

// The loop: one hit per sixteenth of the song's loop. tone -1 = the chord, 0.. = one note of it (counted up the
// voicing). inv = the inversion the lean had. The UI writes the fields, vel last (0 = empty); audio reads.
#define MAXSTEP 128
static volatile uint8_t st_vel[MAXSTEP], st_len[MAXSTEP], st_flag[MAXSTEP];
static volatile int8_t  st_tone[MAXSTEP], st_inv[MAXSTEP];
static volatile int nsteps;               // song.beats * 4 (at most MAXSTEP); 0: no loop
static volatile int muted;                // tap REC: the loop and COMP silent
static volatile int comp_on;              // the keys player is on
static volatile int a_live, a_mode;
static volatile int inv_now;              // the lean's inversion, -3..3
static volatile float bright_now;         // the lean's tone, -1..1
static volatile int pedal_stick, short_stick;
static volatile float stick_motion, stick_drive;
// audio -> UI
#define NV 12                               // voice slots: 8 sounding at once, the rest fading out after a steal
#define POLY 8
static volatile uint8_t v_vnote[NV];
static volatile float   v_vlvl[NV];
static volatile float   v_rot, v_mic_env, v_thr;
static volatile int     v_step = -1;      // the sixteenth that just played (bar position), for the strip

// ---------------------------------------------------------------- voices
typedef struct { float c1, c2, y1, y2, cw; } mres_t;   // a two-pole resonator; cw = cos of its angle (for the damper)
#define NRES 7
typedef struct {
    uint8_t on;                 // 0 free, 1 key down, 2 key up (ringing out, or damped)
    uint8_t model, note, damped;
    int     gate;               // frames the key stays down; -1 until a C_OFF (MIDI)
    float   vel;
    float   env, att, dk, rk;   // envelope: attack step, decay and release factors per sample
    int     stage;              // 1 attack, 2 decay / sustain, 3 release
    float   ph, ph2, ph3, dt;   // oscillator phases (turns) and the step
    float   qs, qc, qcw, qsw;   // a sine by rotation (E.PIANO's modulator, ORGAN's 16', PAD's sub): sin, cos, the step's cos, sin
    float   ts, tc, tcw, tsw;   // E.PIANO's tine, the same way
    float   ie, ik;             // E.PIANO: the bell's index envelope and its decay (log2 per sample); CLAV: the brightness
    float   te, tk;             // E.PIANO: the tine (tk: log2 per sample); ORGAN: the key click (tk: per sample)
    float   lp;                 // CLAV's one-pole
    mres_t  r[NRES]; int nres;  // PIANO, VIBES
    float   nz, nz_lp, nz_k;    // the hammer / mallet / click noise
    float   fade, fstep;        // stealing: down to 0 in 3 ms
    float   pk;                 // its level lately (for stealing and freeing)
    uint32_t age;
} kv_t;
static uint32_t vseed = 0x6a09e667u, vage;

// The bigger state lives in one block from app_alloc (PSRAM), not in internal RAM: the voices (the audio task
// copies a voice into registers per segment, so the cache serves it well), and the UI's own.
#define PEND_N 96
typedef struct {
    kv_t    V[NV];
    parts_t ps;                                  // the scene's sparks
    float   key_down[128], last_down[128];       // how far each key is down (0..1), animated
    hit_t   pend[PEND_N];                        // a first take's hits
    uint8_t bk_vel[MAXSTEP], bk_len[MAXSTEP], bk_flag[MAXSTEP];   // the loop before a take, for a tap's undo
    int8_t  bk_tone[MAXSTEP], bk_inv[MAXSTEP];
} kmem_t;
static kmem_t *M;
#define V         (M->V)
#define ps        (M->ps)
#define key_down  (M->key_down)
#define last_down (M->last_down)
#define pend      (M->pend)
#define bk_vel    (M->bk_vel)
#define bk_len    (M->bk_len)
#define bk_flag   (M->bk_flag)
#define bk_tone   (M->bk_tone)
#define bk_inv    (M->bk_inv)

static inline float midi_to_hz(float m) { return 440.0f * fast_exp2((m - 69.0f) * (1.0f / 12.0f)); }
// sin and cos of x (radians, |x| < 1.6) by their series: tuning a resonator needs them exact at low angles,
// where sin_turns is not, and libm is not for the audio task
static inline void sincos_small(float x, float *s, float *c)
{
    float x2 = x * x;
    *s = x * (1.0f - x2 * (1.0f / 6.0f) * (1.0f - x2 * (1.0f / 20.0f) * (1.0f - x2 * (1.0f / 42.0f) * (1.0f - x2 * (1.0f / 72.0f)))));
    *c = 1.0f - x2 * 0.5f * (1.0f - x2 * (1.0f / 12.0f) * (1.0f - x2 * (1.0f / 30.0f) * (1.0f - x2 * (1.0f / 56.0f))));
}
// a sine at f by rotation: two multiplies and two adds a sample instead of a sine
COLD static void rot_set(float *cw, float *sw, float f)
{
    float w = TWO_PI * clampf(f, 1.0f, 9000.0f) / (float)AUDIO_SR, sh, ch;
    sincos_small(0.5f * w, &sh, &ch);
    *cw = 1.0f - 2.0f * sh * sh; *sw = 2.0f * sh * ch;
}
// rings at f (Hz) for t60 seconds; struck with amp it sounds a sine of about amp. Above 7 kHz it stays silent.
// again: a string struck while it still rings keeps ringing and takes the new blow on top.
COLD static void res_tune(mres_t *r, float f, float t60, float amp, bool again)
{
    if (!again) r->y1 = r->y2 = 0;
    if (f > 7000.0f || f < 20.0f) { r->c1 = r->c2 = 0; r->cw = 1; r->y1 = r->y2 = 0; return; }
    float w = TWO_PI * f / (float)AUDIO_SR, sh, ch;
    sincos_small(0.5f * w, &sh, &ch);
    float cw = 1.0f - 2.0f * sh * sh, sw = 2.0f * sh * ch;
    float rr = fast_exp2(-9.9658f / (t60 * (float)AUDIO_SR));
    r->cw = cw; r->c1 = 2.0f * rr * cw; r->c2 = -rr * rr;
    r->y1 += amp * sw;
}
COLD static void res_damp(mres_t *r, float t60)
{
    if (r->c2 == 0.0f) return;
    float rr = fast_exp2(-9.9658f / (t60 * (float)AUDIO_SR));
    r->c1 = 2.0f * rr * r->cw; r->c2 = -rr * rr;           // the state stays: the ring just dies sooner
}

static float release_s(void) { return P(K_REL); }

COLD static void voice_start(kv_t *v, int model, int note, float vel, int gate)
{
    // a note struck again while it rings keeps its strings, phases and level (no click); otherwise a fresh voice
    bool again = v->on && v->note == note && v->model == model && v->fstep == 0.0f;
    if (!again) memset(v, 0, sizeof *v);
    v->on = 1; v->model = (uint8_t)model; v->note = (uint8_t)note; v->vel = vel; v->gate = gate; v->damped = 0;
    v->fade = 1.0f; v->fstep = 0; v->age = ++vage; v->pk = fmaxf(v->pk, 0.1f * vel);
    float f = midi_to_hz((float)note), reg = ((float)note - 60.0f) / 12.0f;    // octaves from middle C
    v->dt = f / (float)AUDIO_SR;
    v->stage = 1;
    switch (model) {
    case S_PIANO: {
        // partials n f sqrt(1 + B n^2); the lowest two as pairs of strings a little apart; higher ones die sooner
        float B = clampf(0.00025f * fast_exp2(reg * 0.9f), 0.00005f, 0.004f);
        float t1 = clampf(6.0f * fast_exp2(-reg * 0.85f), 0.9f, 14.0f);
        float bright = 0.3f + 0.5f * vel;
        static const float ratio_det[NRES] = { 1.0f, 1.00045f, 2.0f, 2.0011f, 3.0f, 4.0f, 5.0f };
        static const int part[NRES] = { 1, 1, 2, 2, 3, 4, 5 };
        for (int k = 0; k < NRES; k++) {
            int n = part[k];
            float fn = f * ratio_det[k] * sqrtf(1.0f + B * (float)(n * n));
            float a = (k == 1 || k == 3 ? 0.8f : 1.0f) * fast_exp2(-(float)(n - 1) * (1.0f - bright) * 1.6f) / (float)n;
            res_tune(&v->r[k], fn, t1 / (1.0f + 0.55f * (float)((n - 1) * (n - 1))), 0.16f * a * vel, again);
        }
        v->nres = NRES;
        v->nz = 0.12f * vel * vel; v->nz_k = 0.12f + 0.45f * vel;
        v->env = 1.0f; v->stage = 2;
        break;
    }
    case S_VIBES: {
        float t1 = clampf(5.0f * fast_exp2(-reg * 0.5f), 1.2f, 8.0f);
        res_tune(&v->r[0], f, t1, 0.2f * vel, again);
        res_tune(&v->r[1], f * 4.0f, t1 * 0.3f, 0.08f * vel * vel, again);
        res_tune(&v->r[2], f * 10.0f, t1 * 0.1f, 0.035f * vel * vel, again);
        v->nres = 3;
        v->nz = 0.04f * vel; v->nz_k = 0.5f;
        v->env = 1.0f; v->stage = 2;
        break;
    }
    case S_EP:
        rot_set(&v->qcw, &v->qsw, f); rot_set(&v->tcw, &v->tsw, 14.0f * f);
        if (!again) { v->qs = 0; v->qc = 1; v->ph = 0; }
        v->ts = 0; v->tc = 1;
        v->att = 1.0f / (0.0015f * (float)AUDIO_SR);
        v->dk = fast_exp2(-9.9658f / (clampf(4.5f * fast_exp2(-reg * 0.6f), 1.2f, 9.0f) * (float)AUDIO_SR));
        v->ie = 0.12f + 0.55f * vel * vel; v->ik = -1.4427f / (0.12f * (float)AUDIO_SR);
        v->te = f * 14.0f < 13000.0f ? 0.18f * vel : 0.0f; v->tk = -1.4427f / (0.025f * (float)AUDIO_SR);
        break;
    case S_ORGAN:
        v->att = 1.0f / (0.004f * (float)AUDIO_SR); v->dk = 1.0f;
        v->te = 0.08f; v->tk = fast_exp2(-1.4427f / (0.003f * (float)AUDIO_SR));
        rot_set(&v->qcw, &v->qsw, 0.5f * f);
        if (!again) { float a = rng_uni(&vseed); v->qs = sin_turns(a); v->qc = sin_turns(a + 0.25f); }
        break;
    case S_PAD:
        v->att = 1.0f / (0.35f * (float)AUDIO_SR); v->dk = 1.0f;
        rot_set(&v->qcw, &v->qsw, 0.5f * f);
        if (!again) { v->ph = rng_uni(&vseed); v->ph2 = rng_uni(&vseed); v->qs = 0; v->qc = 1; }
        break;
    case S_CLAV:
        v->att = 1.0f / (0.0008f * (float)AUDIO_SR);
        v->dk = fast_exp2(-9.9658f / (clampf(1.4f * fast_exp2(-reg * 0.5f), 0.4f, 3.0f) * (float)AUDIO_SR));
        v->ie = 0.55f + 0.4f * vel; v->ik = -1.4427f / (0.18f * (float)AUDIO_SR);
        break;
    }
}

// the key goes up: the damper (unless the pedal holds it) or the release
COLD static void voice_release(kv_t *v, bool pedal)
{
    if (v->on != 1) return;
    v->on = 2;
    if (pedal) return;
    float r = release_s();
    v->damped = 1;
    switch (v->model) {
    case S_PIANO: for (int k = 0; k < v->nres; k++) res_damp(&v->r[k], 0.12f + 0.5f * r * (k < 2 ? 1.0f : 0.6f)); break;
    case S_VIBES: for (int k = 0; k < v->nres; k++) res_damp(&v->r[k], 0.1f + 0.6f * r); break;
    default: {
        static const float scale[S_N] = { 1, 0.6f, 0.15f, 2.5f, 0.15f, 1 };
        float t = clampf(r * scale[v->model], 0.01f, 10.0f);
        v->rk = fast_exp2(-9.9658f / (t * (float)AUDIO_SR));
        v->stage = 3;
        break;
    }
    }
}

COLD static void note_report(int note, int vel, bool on) { nev_t e = { (uint8_t)note, (uint8_t)vel, (uint8_t)on }; knevq_push(&nevs, &e); }

// The voice for a new note: the same note's own (struck again), a free slot, or, with eight already sounding,
// the quietest of them fades out in 3 ms in its slot while the new note takes another.
COLD static kv_t *voice_for(int note)
{
    for (int i = 0; i < NV; i++) if (V[i].on && V[i].note == note && V[i].fstep == 0.0f) { if (V[i].on == 1) note_report(V[i].note, 0, false); return &V[i]; }
    int busy = 0;
    for (int i = 0; i < NV; i++) if (V[i].on && V[i].fstep == 0.0f) busy++;
    if (busy >= POLY) {
        float q = 1e9f; kv_t *s = NULL;
        for (int i = 0; i < NV; i++) {
            if (!V[i].on || V[i].fstep != 0.0f) continue;
            float l = V[i].pk * (V[i].on == 1 ? 2.0f : 1.0f);
            if (l < q) { q = l; s = &V[i]; }
        }
        if (s) { if (s->on == 1) note_report(s->note, 0, false); s->fstep = 1.0f / (0.003f * (float)AUDIO_SR); }
    }
    for (int i = 0; i < NV; i++) if (!V[i].on) return &V[i];
    kv_t *s = &V[0];                                   // every slot busy fading: the one nearest silence
    for (int i = 0; i < NV; i++) if (V[i].fade < s->fade) s = &V[i];
    s->on = 0;
    return s;
}

// ---------------------------------------------------------------- the chord and its voicing
static int prev_v[5], prev_n;                 // the last close voicing, for voice leading
static int cur_degree = -99;
static int vc_notes[6], vc_n;                 // the voicing now, low to high (for the scene and ARPEGGIO)

COLD static int voicing(int degree, int inv, int vmode, int oct, int *out)
{
    int nt = vmode == VC_SEVENTHS ? 4 : 3;
    int pc[4];
    for (int k = 0; k < nt; k++) pc[k] = ((scale_note(degree + 2 * k, 4) % 12) + 12) % 12;
    int center = 64 + 12 * oct;
    int best[4] = { 0 }; float bs = 1e9f;
    for (int i = 0; i < nt; i++) {                         // each inversion, at each octave near the middle
        for (int base = center - 18; base <= center + 6; base++) {
            if (((base % 12) + 12) % 12 != pc[i]) continue;
            int c[4]; c[0] = base;
            for (int j = 1; j < nt; j++) { int p = pc[(i + j) % nt]; int nn = c[j - 1] + 1; while ((((nn % 12) + 12) % 12) != p) nn++; c[j] = nn; }
            float mean = 0; for (int j = 0; j < nt; j++) mean += (float)c[j];
            mean /= (float)nt;
            float s = 0.6f * fabsf(mean - (float)center);
            if (prev_n == nt) for (int j = 0; j < nt; j++) s += (float)abs(c[j] - prev_v[j]);
            else s *= 3.0f;
            if (s < bs) { bs = s; memcpy(best, c, sizeof best); }
        }
    }
    memcpy(prev_v, best, sizeof best); prev_n = nt;
    int v[6], n = nt;
    memcpy(v, best, sizeof best);
    // the lean: an inversion at a time, up (the lowest note up an octave) or down
    for (int k = 0; k < inv; k++) { int lo = v[0]; for (int j = 0; j < n - 1; j++) v[j] = v[j + 1]; v[n - 1] = lo + 12; }
    for (int k = 0; k > inv; k--) { int hi = v[n - 1]; for (int j = n - 1; j > 0; j--) v[j] = v[j - 1]; v[0] = hi - 12; }
    if (vmode == VC_OPEN && n >= 3) {                      // drop 2: the second from the top an octave down
        int d = v[n - 2] - 12;
        for (int j = n - 2; j > 0; j--) v[j] = v[j - 1];
        v[0] = d;
    }
    if (vmode == VC_SPREAD) {                              // the left hand: the root below
        int r = v[0] - 1; while ((((r % 12) + 12) % 12) != pc[0]) r--;
        if (v[0] - r < 5) r -= 12;
        for (int j = n; j > 0; j--) v[j] = v[j - 1];
        v[0] = r; n++;
    }
    for (int j = 0; j < n; j++) out[j] = clampi(v[j], 28, 100);
    return n;
}

// ---------------------------------------------------------------- the patterns: what each sixteenth of a bar plays
// vel 0 = nothing; tone -1 = the chord, -2 = an arpeggio note (worked out from the step); len in sixteenths
typedef struct { uint8_t vel, len, flags; int8_t tone; } pstep_t;
COLD static pstep_t pat_step(int pat, int s)
{
    pstep_t z = { 0, 0, 0, -1 };
    switch (pat) {
    case PT_WHOLE: if (s == 0) z = (pstep_t){ 100, 15, F_ACCENT, -1 }; break;
    case PT_HALF: if (s == 0 || s == 8) z = (pstep_t){ s ? 88 : 100, 7, s ? 0 : F_ACCENT, -1 }; break;
    case PT_QUARTERS: if (s % 4 == 0) z = (pstep_t){ (uint8_t)(s % 8 == 0 ? 98 : 80), 3, 0, -1 }; break;
    case PT_OFFBEAT: if (s % 4 == 2) z = (pstep_t){ (uint8_t)(s == 6 || s == 14 ? 96 : 84), 1, 0, -1 }; break;
    case PT_STABS: if (s == 0 || s == 6 || s == 12) z = (pstep_t){ (uint8_t)(s == 0 ? 104 : 92), 2, s ? 0 : F_ACCENT, -1 }; break;
    case PT_ARP: if (s % 2 == 0) z = (pstep_t){ (uint8_t)(s % 8 == 0 ? 96 : 78), 3, 0, -2 }; break;
    case PT_GOSPEL:
        if (s == 0) z = (pstep_t){ 104, 6, F_ROLL | F_ACCENT, -1 };
        else if (s == 6 || s == 11 || s == 14) z = (pstep_t){ (uint8_t)(s == 14 ? 90 : 76), 1, 0, -1 };
        else if (s == 8) z = (pstep_t){ 92, 3, F_ROLL, -1 };
        break;
    case PT_BOSSA: if (s == 0 || s == 3 || s == 6 || s == 10 || s == 12) z = (pstep_t){ (uint8_t)(s == 0 ? 96 : 82), 2, 0, -1 }; break;
    }
    return z;
}
// the arpeggio: up and down the voicing, an eighth each
COLD static int arp_tone(uint32_t ka, int n)
{
    if (n < 2) return 0;
    int k = (int)(ka / 2u) % (2 * n - 2);
    return k < n ? k : 2 * n - 2 - k;
}

// ---------------------------------------------------------------- scheduling: notes later in time (swing, the roll, humanize)
typedef struct { uint32_t frame; uint8_t note, vel; int gate; } sched_t;
#define NSCHED 48
static sched_t sq[NSCHED];
static int nsq;
COLD static void schedule(uint32_t frame, int note, int vel, int gate)
{
    if (nsq >= NSCHED) return;
    sq[nsq++] = (sched_t){ frame, (uint8_t)note, (uint8_t)vel, gate };
}

// a hit: the chord (or one note of it) through the voicing, at frame + its delays
static float fps16;
COLD static void play_hit(uint32_t frame, uint32_t nom, int tone, int inv, int vel, int len, int flags, uint32_t ka, int src)
{
    int deg = degree_at(frame);
    int vm = (int)P(K_VOICE), oct = (int)P(K_OCT);
    int notes[6];
    int n = voicing(deg, inv, vm, oct, notes);
    cur_degree = deg;
    memcpy(vc_notes, notes, sizeof notes); vc_n = n;
    float human = P(K_HUMAN) * 0.01f;
    int gate = (int)((float)len * fps16 * (short_stick ? 0.3f : 0.92f));
    if (gate < 600) gate = 600;
    uint32_t base = frame + (uint32_t)(human * 0.010f * (float)AUDIO_SR * rng_uni(&vseed));
    if (tone == -2) tone = arp_tone(ka, n);
    if (tone >= 0) {
        int nt = notes[tone % n] + 12 * (tone / n);
        int v = clampi((int)((float)vel * (1.0f + 0.25f * human * rng_bi(&vseed))), 8, 127);
        schedule(base, nt, v, gate);
    } else {
        float spread = (flags & F_ROLL) ? 0.024f : 0.004f * human;   // a rolled chord, or the hands' natural spread
        for (int j = 0; j < n; j++) {
            int v = clampi((int)((float)vel * (j == 0 || j == n - 1 ? 1.0f : 0.86f) * (1.0f + 0.25f * human * rng_bi(&vseed))), 8, 127);
            schedule(base + (uint32_t)(spread * (float)j * (float)AUDIO_SR), notes[j], v, gate);
        }
    }
    if (src != SRC_LOOP) {
        hit_t h = { nom, (uint8_t)clampi(vel, 1, 127), (uint8_t)clampi(len, 1, 16), (uint8_t)flags, (uint8_t)src, (int8_t)tone, (int8_t)inv };
        khitq_push(&hits, &h);
    }
}

// ---------------------------------------------------------------- audio
static float out_env, bleed_k = 0.3f;
static float env_f, env_s, floor_e = 0.01f, a_f, r_f, a_s, r_s;   // the knock detector (BASS's)
static int   refract;
static float acc[AUDIO_BLOCK];
// the shared chain: tone, motion, drive, level (smoothed per block, interpolated across it)
typedef struct { float cut, mot, drv, fx; } kctl_t;
static kctl_t c0, c1;
static float tf_a, tf_b;                       // the tone filter's state (an SVF low pass)
static float rot_rate, lfo_ph;                 // the motion's rate (the rotor's, with inertia) and phase
#define DLN 512
static float dl[DLN]; static uint32_t dlw;     // the rotor's / pad's moving delay (Doppler)
static float rot_mix, ch_mix;                  // how much of the rotor and of the chorus the chain uses now
static float pedal_was;

static inline float tan_pi(float x) { float t = 3.14159265f * x, t2 = t * t; return t * (1.0f + t2 * (0.33333333f + t2 * (0.13333333f + t2 * 0.05396825f))); }

// Each sound's own loop over the segment, its state in locals (o could alias it otherwise, and every sample would
// go through memory). pk: the level lately (an rms over the segment, for stealing and freeing).
static inline float wrap_add(float p, float d) { p += d; return p >= 1.0f ? p - 1.0f : p; }
// the envelope's stages across a segment: attack (a line up), then decay or sustain (dk), or release (rk)
#define ENV_STEP(env, stage, att, dk, rk) do { if (stage == 1) { env += att; if (env >= 1.0f) { env = 1.0f; stage = 2; } } \
                                                else env *= stage == 2 ? dk : rk; } while (0)

HOT static void render_voice(kv_t *v, float *restrict o, int a, int b)
{
    float fade = v->fade, fs = v->fstep, e2 = 0;
    float env = v->env, att = v->att, dk = v->dk, rk = v->rk;
    int stage = v->stage;
    switch (v->model) {
    case S_PIANO: case S_VIBES: {
        int nr = v->nres;
        float c1[NRES], c2[NRES], y1[NRES], y2[NRES];
        for (int k = 0; k < nr; k++) { c1[k] = v->r[k].c1; c2[k] = v->r[k].c2; y1[k] = v->r[k].y1; y2[k] = v->r[k].y2; }
        const float g = v->model == S_PIANO ? 0.4f : 0.7f;
        float nz = v->nz, nzl = v->nz_lp, nzk = v->nz_k;
        uint32_t sd = vseed;
        for (int i = a; i < b; i++) {
            float y = 0;
            for (int k = 0; k < nr; k++) { float z = c1[k] * y1[k] + c2[k] * y2[k]; y2[k] = y1[k]; y1[k] = z; y += z; }
            if (nz > 1e-4f) { nzl += nzk * (rng_bi(&sd) - nzl); y += nz * nzl; nz *= 0.9965f; }
            if (fs != 0.0f) { fade -= fs; if (fade < 0) fade = 0; }
            y *= g * fade;
            o[i] += y; e2 += y * y;
        }
        vseed = sd; v->nz = nz; v->nz_lp = nzl;
        for (int k = 0; k < nr; k++) { v->r[k].y1 = flush_denormal(y1[k]); v->r[k].y2 = flush_denormal(y2[k]); }
        break;
    }
    case S_EP: {
        // y = sin(phase + index * sin(phase)): the phase by rotation, the bend by a series; the tine (14 x) by rotation
        float qs = v->qs, qc = v->qc, cw = v->qcw, sw = v->qsw;
        float lv = 0.36f * 0.45f * (0.55f + 0.45f * v->vel);
        // the bell's index and the tine die over tens of ms: lines across the segment are close enough
        int len = b - a; if (len < 1) len = 1;
        float ie0 = v->ie * 0.3f + 0.04f, ie1 = v->ie * fast_exp2(v->ik * (float)len) * 0.3f + 0.04f, die = (ie1 - ie0) / (float)len, idx = ie0;
        float te0 = v->te, te1 = v->te * fast_exp2(v->tk * (float)len), dte = (te1 - te0) / (float)len, te = te0;
        bool tine = te0 > 1e-4f;
        float ts = v->ts, tc = v->tc, tcw = v->tcw, tsw = v->tsw;
        for (int i = a; i < b; i++) {
            ENV_STEP(env, stage, att, dk, rk);
            float ns = qs * cw + qc * sw; qc = qc * cw - qs * sw; qs = ns;
            // sin(phase + th) = sin(phase) cos(th) + cos(phase) sin(th), th = 2 pi idx sin(phase) (|th| < 1.6): series
            float th = TWO_PI * idx * qs, t2 = th * th;
            float st = th * (1.0f - t2 * (0.16666667f - t2 * (0.0083333333f - t2 * 0.00019841270f)));
            float ct = 1.0f - t2 * (0.5f - t2 * (0.041666667f - t2 * 0.0013888889f));
            float y = qs * ct + qc * st;
            idx += die;
            if (tine) { float t = ts * tcw + tc * tsw; tc = tc * tcw - ts * tsw; ts = t; y += te * t; te += dte; }
            if (fs != 0.0f) { fade -= fs; if (fade < 0) fade = 0; }
            y *= lv * env * fade;
            o[i] += y; e2 += y * y;
        }
        float gn = 1.5f - 0.5f * (qs * qs + qc * qc);            // keep the rotation on the circle
        v->qs = qs * gn; v->qc = qc * gn;
        gn = 1.5f - 0.5f * (ts * ts + tc * tc); v->ts = ts * gn; v->tc = tc * gn;
        v->ie = (ie1 - 0.04f) / 0.3f; v->te = tine ? te1 : 0.0f;
        break;
    }
    case S_ORGAN: {
        // drawbars on the 16' sine: harmonics 1 2 3 4 6 8 of half the note at 0.45 1 0.55 0.5 0.22 0.28, as sin(x) times a
        // polynomial in cos(x) (sin(h x) = sin(x) U_h-1(cos x), Chebyshev), worked out once
        float s1 = v->qs, c1 = v->qc, cw = v->qcw, sw = v->qsw, lv = 0.085f * 0.62f;
        float te = v->te, tk = v->tk;
        uint32_t sd = vseed;
        for (int i = a; i < b; i++) {
            if (stage == 1) { env += att; if (env >= 1.0f) { env = 1.0f; stage = 2; } }
            else if (stage == 3) env *= rk;
            float ns = s1 * cw + c1 * sw; c1 = c1 * cw - s1 * sw; s1 = ns;
            float cc = c1 * c1;
            float y = s1 * (-0.10f + c1 * (-0.92f + 2.2f * c1) + c1 * cc * (19.36f + cc * (-46.72f + 35.84f * cc)));
            if (te > 1e-4f) { y += te * rng_bi(&sd) * 6.0f; te *= tk; }
            if (fs != 0.0f) { fade -= fs; if (fade < 0) fade = 0; }
            y *= lv * env * fade;
            o[i] += y; e2 += y * y;
        }
        vseed = sd; v->te = te;
        float gn = 1.5f - 0.5f * (s1 * s1 + c1 * c1);
        v->qs = s1 * gn; v->qc = c1 * gn;
        break;
    }
    case S_PAD: {
        float dt = v->dt, d1 = dt * 1.0041f, d2 = dt * 0.9959f, p1 = v->ph, p2 = v->ph2, qs = v->qs, qc = v->qc, cw = v->qcw, sw = v->qsw;
        float lv = 0.11f * 0.72f, lp = v->lp;
        for (int i = a; i < b; i++) {
            if (stage == 1) { env += att; if (env >= 1.0f) { env = 1.0f; stage = 2; } }
            else if (stage == 3) env *= rk;
            p1 = wrap_add(p1, d1); p2 = wrap_add(p2, d2);
            float ns = qs * cw + qc * sw; qc = qc * cw - qs * sw; qs = ns;
            float y = saw_blep(p1, d1) + saw_blep(p2, d2) + 0.35f * qs;
            lp += 0.12f * (y - lp);
            if (fs != 0.0f) { fade -= fs; if (fade < 0) fade = 0; }
            y = lp * lv * env * fade;
            o[i] += y; e2 += y * y;
        }
        float gn = 1.5f - 0.5f * (qs * qs + qc * qc);
        v->ph = p1; v->ph2 = p2; v->qs = qs * gn; v->qc = qc * gn; v->lp = flush_denormal(lp);
        break;
    }
    case S_CLAV: {
        float dt = v->dt, ph = v->ph, lv = 0.2f * 0.5f * (0.5f + 0.5f * v->vel), lp = v->lp;
        int len = b - a; if (len < 1) len = 1;
        float ie0 = v->ie, ie1 = v->ie * fast_exp2(v->ik * (float)len), die = (ie1 - ie0) / (float)len, ie = ie0;
        for (int i = a; i < b; i++) {
            ENV_STEP(env, stage, att, dk, rk);
            ph = wrap_add(ph, dt);
            float p2 = ph + 0.22f; if (p2 >= 1.0f) p2 -= 1.0f;
            float y = saw_blep(ph, dt) - saw_blep(p2, dt);       // a narrow pulse
            lp += (0.06f + 0.9f * ie) * (y - lp);                // bright at the pluck, darker as it dies
            if (fs != 0.0f) { fade -= fs; if (fade < 0) fade = 0; }
            y = (lp + 0.3f * (y - lp) * ie) * lv * env * fade;
            ie += die;
            o[i] += y; e2 += y * y;
        }
        v->ph = ph; v->lp = flush_denormal(lp); v->ie = ie1;
        break;
    }
    }
    v->env = flush_denormal(env); v->stage = stage;
    v->fade = fade;
    if (b > a) { float pk = 1.4f * sqrtf(e2 / (float)(b - a)); v->pk = pk > v->pk ? pk : v->pk * 0.97f + pk * 0.03f; }
    if (fade <= 0.0f) { if (v->on == 1) note_report(v->note, 0, false); v->on = 0; }
}

HOT static void render(int a, int b)
{
    if (b <= a) return;
    for (int k = 0; k < NV; k++) if (V[k].on) render_voice(&V[k], acc, a, b);
}

COLD static void start_note(int note, int vel, int gate)
{
    kv_t *v = voice_for(note);
    voice_start(v, (int)P(K_SOUND), note, (float)vel / 127.0f, gate);
    note_report(note, vel, true);
}

HOT static void audio(const float *mic, float *restrict dry, float *restrict send, int n, bool live)
{
    if (!M) return;
    uint32_t f0 = audio_frames();
    a_live = live;
    fps16 = song_frames_per_beat() * 0.25f;
    memset(acc, 0, (size_t)n * sizeof(float));
    // MIDI keys from the UI, at the block's start
    cmd_t c;
    while (kcmdq_pop(&cmds, &c)) {
        if (c.kind == C_ON) schedule(f0, c.note, c.vel, -1);
        else for (int i = 0; i < NV; i++) if (V[i].on == 1 && V[i].gate < 0 && (c.kind == C_ALLOFF || V[i].note == c.note)) {
            note_report(V[i].note, 0, false); voice_release(&V[i], pedal_was > 0.5f);
        }
    }
    // the keys' gates, the pedal (to the block)
    float pedal = (P(K_PEDAL) >= 1.0f || pedal_stick) ? 1.0f : 0.0f;
    for (int i = 0; i < NV; i++) {
        kv_t *v = &V[i];
        if (v->on == 1 && v->gate > 0) { v->gate -= n; if (v->gate <= 0) { note_report(v->note, 0, false); voice_release(v, pedal > 0.5f); } }
        if (v->on == 2 && !v->damped && pedal < 0.5f) { v->on = 1; voice_release(v, false); }   // the pedal let go: the dampers fall
        if (v->on == 2 && v->pk < 0.00005f && v->fade > 0.0f) v->on = 0;                       // rung out
    }
    pedal_was = pedal;
    // the steps this block crosses: the loop's hits first, COMP fills the rest
    bool comp = !muted && a_mode == M_COMP && (comp_on || (live && a_mode == M_COMP));
    bool loop = !muted && nsteps > 0 && song.loop_len;
    if (comp || loop) {
        float b0 = song_beat(f0) * 4.0f, b1 = song_beat(f0 + (uint32_t)n) * 4.0f;
        float total = song.loop_len && song.beats ? (float)(song.beats * 4) : (float)(SONG_WRAP_BEATS * 4);
        float span = b1 - b0;
        if (span < 0) span += total;
        if (span > 0 && span < 8.0f) {
            int pat = (int)P(K_PAT);
            float swing = P(K_SWING) * 0.01f;
            for (float k = floorf(b0) + 1.0f; k <= b0 + span + 1e-6f; k += 1.0f) {
                int at = (int)((k - b0) / span * (float)n);
                if (at >= n) at = n - 1;
                float kk = k >= total ? k - total : k;
                uint32_t ka = (uint32_t)(kk + 0.5f);
                int s = (int)(ka % 16u);
                uint32_t nom = f0 + (uint32_t)at, fr = nom;
                // swing: the offbeat eighths late (and the odd sixteenths half as much)
                if (s % 4 == 2) fr += (uint32_t)(swing * fps16);
                else if (s & 1) fr += (uint32_t)(swing * 0.5f * fps16);
                int st = nsteps > 0 ? (int)(ka % (uint32_t)nsteps) : -1;
                if (loop && st >= 0 && st_vel[st]) {
                    play_hit(fr, nom, st_tone[st], st_inv[st], st_vel[st], st_len[st], st_flag[st], ka, SRC_LOOP);
                    v_step = s;
                } else if (comp) {
                    pstep_t p = pat_step(pat, s);
                    if (p.vel) {
                        int vel = clampi((int)((float)p.vel * (0.45f + 0.75f * P(K_TOUCH) * 0.01f)), 10, 127);
                        play_hit(fr, nom, p.tone, inv_now, vel, p.len, p.flags, ka, SRC_COMP);
                        v_step = s;
                    }
                }
            }
        }
    }
    // a knock (KNOCK, live): the chord now
    if (live && a_mode == M_KNOCK) {
        for (int i = 0; i + 1 < n; i += 2) {                       // the envelopes at 16 kHz
            float x = fmaxf(fabsf(mic ? mic[i] : 0.0f), fabsf(mic ? mic[i + 1] : 0.0f));
            follow(&env_f, x, a_f, r_f);
            float slow_before = env_s;
            follow(&env_s, x, a_s, r_s);
            if (env_s < floor_e) floor_e += 0.01f * (env_s - floor_e); else floor_e += 0.000005f * (env_s - floor_e);
            float bleed = bleed_k * out_env, thr = 0.02f + 4.0f * floor_e + 0.4f * bleed;
            if (refract > 0) refract--;
            else if (env_f - bleed > thr && env_f - bleed > 2.5f * (slow_before - bleed) + 0.005f) {
                int vel = clampi((int)((env_f - bleed) / 0.3f * 127.0f), 30, 127);
                uint32_t fr = f0 + (uint32_t)i;
                play_hit(fr, fr, -1, inv_now, vel, 4, vel > 110 ? F_ACCENT : 0, (uint32_t)floorf(song_beat(fr) * 4.0f + 0.5f), SRC_LIVE);
                refract = (int)(0.06f * (float)AUDIO_SR / 2.0f);
            }
        }
    }
    // the notes due in this block, in time order, between segments of the voices
    int pos = 0;
    for (;;) {
        int bi = -1, bat = n;
        for (int j = 0; j < nsq; j++) {
            int at = (int)(int32_t)(sq[j].frame - f0);
            if (at < 0) at = 0;
            if (at < n && (bi < 0 || at < bat)) { bi = j; bat = at; }
        }
        if (bi < 0) break;
        render(pos, bat); pos = bat;
        start_note(sq[bi].note, sq[bi].vel, sq[bi].gate);
        sq[bi] = sq[--nsq];
    }
    render(pos, n);
    // the chain: tone, motion, drive, level
    int model = (int)P(K_SOUND);
    c0 = c1;
    const float kb = 0.1f;
    float cut = 350.0f * fast_exp2(clampf(P(K_TONE) * 0.01f + 0.35f * bright_now, 0.0f, 1.25f) * 5.2f);   // 350 Hz .. 12 kHz
    c1.cut += kb * (clampf(cut, 200.0f, 13000.0f) - c1.cut);
    c1.mot += kb * (clampf(P(K_MOTION) * 0.01f + stick_motion, 0.0f, 1.0f) - c1.mot);
    c1.drv += kb * (clampf(P(K_DRIVE) * 0.01f + stick_drive, 0.0f, 1.0f) - c1.drv);
    c1.fx  += kb * (P(K_FX) * 0.01f - c1.fx);
    if (c0.cut <= 0) c0 = c1;
    float gA = tan_pi(c0.cut / (float)AUDIO_SR), gB = tan_pi(c1.cut / (float)AUDIO_SR);
    const float kq = 1.2f;                                         // a gentle slope, no peak
    float a1A = 1.0f / (1.0f + gA * (gA + kq)), a1B = 1.0f / (1.0f + gB * (gB + kq));
    float a2A = gA * a1A, a2B = gB * a1B, a3A = gA * a2A, a3B = gB * a2B;
    float inv = 1.0f / (float)n;
    float da1 = (a1B - a1A) * inv, da2 = (a2B - a2A) * inv, da3 = (a3B - a3A) * inv;
    float a1 = a1A, a2 = a2A, a3 = a3A;
    float mot = c0.mot, dmot = (c1.mot - c0.mot) * inv, drv = c0.drv, ddrv = (c1.drv - c0.drv) * inv, fx = c0.fx, dfx = (c1.fx - c0.fx) * inv;
    // the motion: the organ's rotor spins up and down slowly (chorale to tremolo), the pad a slow chorus, the rest a
    // tremolo. Which one blends over about 30 ms when the sound changes, so the notes still ringing never jump.
    bool rotor = model == S_ORGAN, chorus = model == S_PAD;
    float want_rate = rotor ? (c1.mot < 0.02f ? 0.0f : 0.7f + 6.2f * c1.mot * c1.mot) : chorus ? 0.35f + 0.6f * c1.mot
                    : model == S_VIBES ? 2.5f + 4.0f * c1.mot : 4.2f + 2.0f * c1.mot;
    rot_rate += (rotor ? 0.006f : 0.05f) * (want_rate - rot_rate);   // the rotor's inertia: a second or so
    float rstep = rot_rate / (float)AUDIO_SR;
    float rmA = rot_mix, cmA = ch_mix;
    rot_mix += 0.07f * ((rotor ? 1.0f : 0.0f) - rot_mix); ch_mix += 0.07f * ((chorus ? 1.0f : 0.0f) - ch_mix);
    float rm = rmA, drm = (rot_mix - rmA) * inv, cm = cmA, dcm = (ch_mix - cmA) * inv;
    bool moving = rmA > 1e-4f || rot_mix > 1e-4f || cmA > 1e-4f || ch_mix > 1e-4f;
    float l = sin_turns(lfo_ph);                                    // the motion's LFO: slow, so a line across the block
    lfo_ph = wrap1(lfo_ph + rstep * (float)n);
    float dl_ = (sin_turns(lfo_ph) - l) * inv;
    const float G = 0.78f;
    float gA2 = G / (1.0f + 1.6f * c0.drv), gB2 = G / (1.0f + 1.6f * c1.drv), og = gA2, dog = (gB2 - gA2) * inv;
    float pk = 0, za = tf_a, zb = tf_b;                         // the states in locals: dry[] and send[] could alias globals
    uint32_t w = dlw;
    float *restrict dly = dl;
    for (int i = 0; i < n; i++) {
        float x = acc[i];
        // tone: the SVF's low pass
        float v3 = x - zb, v1 = a1 * za + a2 * v3, v2 = zb + a2 * za + a3 * v3;
        za = 2.0f * v1 - za; zb = 2.0f * v2 - zb;
        float y = v2;
        // motion
        dly[w & (DLN - 1)] = y; w++;
        float y_am = y * (1.0f - 0.5f * mot * (0.5f + 0.5f * l));
        if (moving) {
            float dr = 70.0f + 22.0f * mot * l, dc = 160.0f + 60.0f * mot * l;
            int ri = (int)dr, ci = (int)dc; float rf = dr - (float)ri, cf = dc - (float)ci;
            float r0 = dly[(w - (uint32_t)ri) & (DLN - 1)], r1 = dly[(w - (uint32_t)ri - 1) & (DLN - 1)];
            float q0 = dly[(w - (uint32_t)ci) & (DLN - 1)], q1 = dly[(w - (uint32_t)ci - 1) & (DLN - 1)];
            float y_rot = y * (1.0f - 0.55f * mot) + (r0 + (r1 - r0) * rf) * 0.55f * mot * (1.0f + 0.35f * l);
            float y_ch = y * (1.0f - 0.45f * mot) + (q0 + (q1 - q0) * cf) * 0.45f * mot;
            y = y_am * (1.0f - rm - cm) + y_rot * rm + y_ch * cm;
        } else y = y_am;
        l += dl_;
        // drive: a cubic soft clip, level kept
        float g = 1.0f + 4.0f * drv, u = clampf(y * g, -1.5f, 1.5f);
        y = og * (u - 0.148148f * u * u * u);
        dry[i] += y;
        send[i] += y * fx;
        float ay = fabsf(y); if (ay > pk) pk = ay;
        a1 += da1; a2 += da2; a3 += da3; mot += dmot; drv += ddrv; fx += dfx; rm += drm; cm += dcm; og += dog;
    }
    tf_a = flush_denormal(za); tf_b = flush_denormal(zb); dlw = w;
    v_rot = lfo_ph;
    out_env = pk > out_env ? pk : out_env * 0.96f;
    if (live && a_mode == M_KNOCK && out_env > 0.03f) {           // how much of the keys the mic hears (learned, as KNOCK does)
        float r = env_s / out_env;
        bleed_k += (r < bleed_k ? 0.05f : 0.002f) * (r - bleed_k);
        bleed_k = clampf(bleed_k, 0.01f, 2.0f);
    }
    for (int i = 0; i < NV; i++) { v_vnote[i] = V[i].note; v_vlvl[i] = V[i].on ? clampf(V[i].pk * 6.0f, 0.0f, 1.0f) * V[i].fade : 0.0f; }
    v_mic_env = env_s;
    v_thr = 0.02f + 4.0f * floor_e + bleed_k * out_env;
}

COLD static void init(void)
{
    kcmdq_clear(&cmds); khitq_clear(&hits); knevq_clear(&nevs);
    if (!M) M = app_alloc_fast(sizeof(kmem_t));            // the voices are read and written every sample: internal RAM
    if (!M) app_log("keys: no memory for the voices: silent");
    a_f = onepole_s(0.00015f); r_f = onepole_s(0.005f); a_s = onepole_s(0.015f); r_s = onepole_s(0.100f);
    c1 = (kctl_t){ .cut = 4000.0f, .mot = P(K_MOTION) * 0.01f, .drv = P(K_DRIVE) * 0.01f, .fx = P(K_FX) * 0.01f };
    rot_mix = P(K_SOUND) == S_ORGAN ? 1.0f : 0.0f; ch_mix = P(K_SOUND) == S_PAD ? 1.0f : 0.0f;
}

// ---------------------------------------------------------------- UI
static bool was_live, rec_on, rec_first, retake;
static int  live_ms, inv_ladder;
static uint32_t rec_start;
static int npend;
static uint32_t my_loop_len, my_loop_start;
static uint8_t held[16]; static int nheld;
// the scene
static uint32_t pseed = 0x5be0cd19u;
static int   flash_ms, hit_count;

COLD static int quantize(uint32_t frame)
{
    if (!nsteps) return -1;
    int s = (int)floorf(song_beat(frame) * 4.0f + 0.5f);
    return ((s % nsteps) + nsteps) % nsteps;
}

COLD static void write_step(int st, const hit_t *h)
{
    if (st < 0 || st >= MAXSTEP) return;
    st_vel[st] = 0;
    st_len[st] = h->len; st_flag[st] = h->flags; st_tone[st] = h->tone; st_inv[st] = h->inv;
    __atomic_store_n(&st_vel[st], (uint8_t)clampi(h->vel, 1, 127), __ATOMIC_RELEASE);
}

COLD static void clear_steps(void) { for (int i = 0; i < MAXSTEP; i++) st_vel[i] = 0; }
COLD static void clear(void) { clear_steps(); comp_on = 0; npend = 0; rec_on = false; muted = 0; }

COLD static void record(const hit_t *h)
{
    if (!rec_on) return;
    if (rec_first) { if (npend < PEND_N) pend[npend++] = *h; return; }
    write_step(quantize(h->frame), h);
}

COLD static void first_loop_done(uint32_t end)
{
    if (!song.loop_len) {                                    // the loop starts at the first chord: the silence before it is cut
        uint32_t s0 = npend ? pend[0].frame : rec_start;
        if ((int32_t)(s0 - rec_start) < 0 || (int32_t)(end - s0) < AUDIO_SR / 4) s0 = rec_start;
        host_first_loop(s0, end - s0);
    }
    nsteps = song.loop_len && song.beats ? clampi(song.beats * 4, 1, MAXSTEP) : 0;
    my_loop_len = song.loop_len; my_loop_start = song.loop_start;
    clear_steps();
    for (int i = 0; i < npend && nsteps; i++) write_step(quantize(pend[i].frame), &pend[i]);   // by their absolute frames
    npend = 0;
}

COLD static void tick(const ctl_t *c, bool live)
{
    if (!M) return;
    int mode = (int)P(K_MODE);
    a_mode = mode;
    // the song's loop: steps follow its length; a new loop (or none) forgets ours. A start that only crept by a few
    // frames (the link keeping time with another board) is the same loop.
    if (song.loop_len != my_loop_len || song.loop_start != my_loop_start) {
        bool same = song.loop_len && song.loop_len == my_loop_len;
        if (same) { int32_t d = song_mod((int32_t)(song.loop_start - my_loop_start), (int32_t)song.loop_len); same = d < 256 || d > (int32_t)song.loop_len - 256; }
        if (same) my_loop_start = song.loop_start;
        else if (!(rec_on && rec_first)) {
            if (my_loop_len) clear_steps();
            my_loop_len = song.loop_len; my_loop_start = song.loop_start;
            nsteps = song.loop_len && song.beats ? clampi(song.beats * 4, 1, MAXSTEP) : 0;
        }
    }
    if (live) {
        live_ms = was_live ? live_ms + 10 : 0;
        // the lean: the voicing up or down an inversion (bottom edge down: up), the tone open or dark (right: open)
        if (c->has_imu) {
            float p = c->lean_y / 9.0f;
            if (p > (float)inv_ladder + 0.65f) inv_ladder++;
            if (p < (float)inv_ladder - 0.65f) inv_ladder--;
            inv_ladder = clampi(inv_ladder, -3, 3);
            float lx = c->lean_x;
            bright_now = fabsf(lx) < 5.0f ? 0.0f : clampf((lx - (lx > 0 ? 5.0f : -5.0f)) / 30.0f, -1.0f, 1.0f);
        }
        inv_now = inv_ladder;
        // the stick: up the pedal, down short notes, right the motion, left the grit
        if (c->has_joy) {
            pedal_stick = c->jy > 0.5f;
            short_stick = c->jy < -0.5f;
            stick_motion = c->jx > 0.15f ? (c->jx - 0.15f) * 1.2f : 0.0f;
            stick_drive = c->jx < -0.15f ? (-c->jx - 0.15f) * 0.9f : 0.0f;
        } else { pedal_stick = short_stick = 0; stick_motion = stick_drive = 0; }
        // COMP: the keys player joins after a second here with the menu closed
        if (mode == M_COMP && !c->menu_open && live_ms >= 1000 && !muted) comp_on = 1;
        // REC: hold = record (or add), tap = mute; held while muted = a new take (the old steps go at the press, and come
        // back if it was a tap)
        if (c->rec_press) {
            rec_on = true; rec_start = c->frames; rec_first = song.loop_len == 0; npend = 0;
            for (int i = 0; i < MAXSTEP; i++) { bk_vel[i] = st_vel[i]; bk_len[i] = st_len[i]; bk_flag[i] = st_flag[i]; bk_tone[i] = st_tone[i]; bk_inv[i] = st_inv[i]; }
            retake = muted && !rec_first;
            if (retake) clear_steps();
        }
        if (retake && rec_on && c->rec && c->rec_ms >= 300) { retake = false; muted = 0; toast("NEW TAKE", 900); coach_done(LEARN_INST + 11); }
        if (c->rec_release && rec_on) {
            rec_on = false; retake = false;
            if (c->rec_ms < 300) {                           // a tap: nothing was meant to be recorded
                if (!rec_first) for (int i = MAXSTEP - 1; i >= 0; i--) { st_len[i] = bk_len[i]; st_flag[i] = bk_flag[i]; st_tone[i] = bk_tone[i]; st_inv[i] = bk_inv[i]; st_vel[i] = bk_vel[i]; }
                npend = 0;
                muted = !muted;
                if (muted) comp_on = 0;
                toast(muted ? "KEYS MUTED" : "KEYS ON", 900);
                coach_done(LEARN_INST + 1);
            } else if (rec_first) first_loop_done(c->frames);
        }
    } else {
        if (was_live) { pedal_stick = short_stick = 0; stick_motion = stick_drive = 0; }
        if (rec_on) { rec_on = false; if (rec_first && npend) first_loop_done(c->frames); }
        live_ms = 0;
    }
    if (mode != M_COMP) comp_on = 0;
    was_live = live;
    // what was hit: the loop; what sounded: MIDI and the scene
    hit_t h;
    while (khitq_pop(&hits, &h)) {
        record(&h);
        if (live) {
            hit_count++;
            flash_ms = 110;
        }
    }
    nev_t e;
    while (knevq_pop(&nevs, &e)) {
        host_midi_note(L_KEYS, e.note, e.on ? e.vel : 0);
        if (e.on && live) key_down[e.note & 127] = 1.0f;
    }
    if (flash_ms > 0) flash_ms -= 10;
}

// ---------------------------------------------------------------- MIDI in (while live): the keys play it
COLD static void midi_in(uint8_t st, uint8_t d1, uint8_t d2)
{
    uint8_t k = st & 0xF0;
    if (k == 0x90 && d2 > 0) { cmd_t cm = { C_ON, d1, d2 }; kcmdq_push(&cmds, &cm); if (nheld < 16) held[nheld++] = d1; }
    else if (k == 0x80 || (k == 0x90 && d2 == 0)) { cmd_t cm = { C_OFF, d1, 0 }; kcmdq_push(&cmds, &cm); }
    else if (k == 0xB0 && d1 == 123) { cmd_t cm = { C_ALLOFF, 0, 0 }; kcmdq_push(&cmds, &cm); nheld = 0; }
}

static void changed(int p) { (void)p; }        // everything is read per block or per tick: safe before init

COLD static int state(void)
{
    if (rec_on) return LOOP_REC;
    bool any = false;
    for (int i = 0; i < nsteps && !any; i++) if (st_vel[i]) any = true;
    if (!any) return muted ? LOOP_OFF : LOOP_NONE;
    return muted ? LOOP_OFF : LOOP_ON;
}
COLD static bool playing(void) { return comp_on && !muted && P(K_MODE) == M_COMP; }

// ---------------------------------------------------------------- the scene
static const char *const nnames[12] = { "C", "C#", "D", "D#", "E", "F", "F#", "G", "G#", "A", "A#", "B" };
COLD static void chord_label(int degree, char *b, int n)
{
    int nt = (int)P(K_VOICE) == VC_SEVENTHS ? 4 : 3;
    int r = scale_note(degree, 4), t3 = scale_note(degree + 2, 4) - r, t5 = scale_note(degree + 4, 4) - r, t7 = scale_note(degree + 6, 4) - r;
    const char *q = t3 == 3 ? (t5 == 6 ? "o" : "m") : (t5 == 8 ? "+" : "");
    const char *s = "";
    if (nt == 4) {
        if (t3 == 4 && t7 == 11) { q = ""; s = "MAJ7"; }
        else if (t3 == 4 && t7 == 10) { q = ""; s = "7"; }
        else if (t3 == 3 && t5 == 6) { q = "m"; s = "7b5"; }
        else if (t3 == 3) { q = "m"; s = "7"; }
    }
    snprintf(b, (size_t)n, "%s%s%s", nnames[((r % 12) + 12) % 12], q, s);
}

// two octaves of keys at y, from C of octave lo
#define KB_Y 30
#define KB_H 15
static const int white_pc[7] = { 0, 2, 4, 5, 7, 9, 11 };
static bool is_black(int pc) { return pc == 1 || pc == 3 || pc == 6 || pc == 8 || pc == 10; }
COLD static int  key_x(int note, int lo, int *w)        // x of a key in the two-octave window, its width (0: off the window)
{
    int o = note - lo;
    if (o < 0 || o >= 24) { *w = 0; return 0; }
    int oct = o / 12, pc = o % 12;
    if (is_black(pc)) { int wi = 0; while (white_pc[wi] < pc) wi++; *w = 5; return 1 + (oct * 7 + wi) * 9 - 3; }
    int wi = 0; while (white_pc[wi] != pc) wi++;
    *w = 9; return 1 + (oct * 7 + wi) * 9;
}

COLD static void draw_keys(int lo, uint32_t frame)
{
    (void)frame;
    // the white keys
    for (int k = 0; k < 14; k++) oled_line(1 + k * 9, KB_Y, 1 + k * 9, KB_Y + KB_H, true);
    oled_line(127, KB_Y, 127, KB_Y + KB_H, true);
    oled_line(1, KB_Y + KB_H, 127, KB_Y + KB_H, true);
    oled_line(1, KB_Y, 127, KB_Y, true);
    for (int o = 0; o < 24; o++) {
        int pc = o % 12; if (is_black(pc)) continue;
        float d = key_down[(lo + o) & 127];
        if (d < 0.02f) continue;
        int w, x = key_x(lo + o, lo, &w);
        int sink = d > 0.7f ? 2 : 1;                       // a key going down sinks, then rises as it fades
        int lvl = d > 0.55f ? 4 : d > 0.3f ? 3 : d > 0.12f ? 2 : 1;
        oled_dither(x + 1, KB_Y + 1 + sink, w - 1, KB_H - 1 - sink, lvl, true);
        oled_line(x + 1, KB_Y + KB_H - 1, x + w - 1, KB_Y + KB_H - 1, false);
    }
    // the black keys over them
    for (int o = 0; o < 24; o++) {
        int pc = o % 12; if (!is_black(pc)) continue;
        int w, x = key_x(lo + o, lo, &w);
        float d = key_down[(lo + o) & 127];
        oled_rect(x, KB_Y, w, 9, true);
        if (d > 0.02f) { int sink = d > 0.7f ? 2 : 1; oled_rect(x + 1, KB_Y + 1, w - 2, 7, false); oled_rect(x + 1, KB_Y + 2 + sink, w - 2, 5 - sink, d > 0.3f); }
    }
}

COLD static void draw(const view_t *v)
{
    if (!M) return;
    int mode = (int)P(K_MODE), snd = (int)P(K_SOUND);
    parts_step(&ps, 0.04f, -60.0f, 0.97f);
    // the keys follow the voices: down with a note, rising as it fades
    for (int i = 0; i < 128; i++) key_down[i] *= 0.82f;
    for (int i = 0; i < NV; i++) { float l = v_vlvl[i]; int nt = v_vnote[i]; if (l > key_down[nt]) key_down[nt] = l; }
    // the window: two octaves from a C near the voicing
    int lo_note = 127;
    for (int i = 0; i < NV; i++) if (v_vlvl[i] > 0.05f && v_vnote[i] < lo_note) lo_note = v_vnote[i];
    static int lo = 48;
    if (lo_note < 127) {
        int want = ((lo_note - 2) / 12) * 12;
        if (lo_note < lo || lo_note >= lo + 24 - 4) lo = clampi(want, 24, 96);
    }
    // ---- the mode, the pattern, the sound; the chord at the right
    int px = oled_pill(F_SMALL, 1, 17, mode_l[mode], mode == M_COMP && (comp_on || a_live) && !muted);
    oled_ftext_ex(F_TINY, px + 4, 18, mode == M_COMP ? pat_l[(int)P(K_PAT)] : "KNOCK THE BOX", 1);
    oled_ftext_ex(F_TINY, px + 4, 24, sound_l[snd], 1);
    char cn[12]; chord_label(cur_degree > -99 ? cur_degree : song.degree, cn, sizeof cn);
    int cw = oled_ftext_w(F_MED, cn, 1);
    oled_ftext_r(F_MED, OLED_W - (snd == S_ORGAN ? 14 : 2), 17, cn, 1);
    if (flash_ms > 0) oled_invert(OLED_W - (snd == S_ORGAN ? 14 : 2) - cw - 1, 16, cw + 2, 12);
    if (snd == S_ORGAN) {                                         // the rotor's horn, spinning with the motion
        float a = v_rot * TWO_PI;
        int cx = OLED_W - 6, cy = 22;
        oled_circle(cx, cy, 4, true);
        oled_line(cx, cy, cx + (int)lroundf(4.0f * cosf(a)), cy + (int)lroundf(4.0f * sinf(a)), true);
        oled_line(cx, cy, cx - (int)lroundf(4.0f * cosf(a)), cy - (int)lroundf(4.0f * sinf(a)), true);
    }
    if (inv_now) { char b[8]; snprintf(b, sizeof b, "%s%d", inv_now > 0 ? S_UP : S_DOWN, abs(inv_now)); oled_ftext_r(F_TINY, OLED_W - 2, 25, b, 1); }
    // ---- the keyboard
    draw_keys(lo, v->frame);
    // sparks from the struck keys
    for (int nt = lo; nt < lo + 24; nt++) {
        if (key_down[nt] > 0.9f && last_down[nt] <= 0.9f) {
            int w, x = key_x(nt, lo, &w);
            if (w) parts_emit(&ps, (float)(x + w / 2), (float)KB_Y - 1, rng_bi(&pseed) * 8.0f, -25.0f - 20.0f * rng_uni(&pseed), 0.35f, PART_DOT, 1);
        }
    }
    for (int nt = 0; nt < 128; nt++) last_down[nt] = key_down[nt];
    parts_draw(&ps);
    if (muted) { oled_rrect(44, 33, 40, 9, 2, false); oled_rframe(44, 33, 40, 9, 2); oled_ftext_c(F_TINY, 64, 35, "MUTED", 1); }
    // ---- the rhythm: the loop's hits, or the pattern's bar, and where it is (the core may cover these rows). A hit
    // is a block as tall as it is hard (an arpeggio's notes sit at their height in the chord), its length a line
    // after it; the step playing now jumps up.
    if (!v->cover) {
        int ns = nsteps;
        bool has_loop = false;
        for (int s = 0; s < ns && !has_loop; s++) if (st_vel[s]) has_loop = true;
        bool run = !muted && (has_loop || (mode == M_COMP && (comp_on || a_live)));
        int steps = has_loop ? ns : 16;
        if (has_loop || mode == M_COMP) {
            int cur = (int)(song_beat(audio_frames()) * 4.0f) % steps;
            float cw = 124.0f / (float)steps;
            for (int s = 0; s < steps; s += 4) oled_pixel(2 + (int)((float)s * cw), 63, true);
            oled_hline_pat(2, 62, 124, 0x11, true);
            for (int s = 0; s < steps; s++) {
                int vel, len, tone;
                if (has_loop) { vel = st_vel[s]; len = st_len[s]; tone = st_tone[s]; }
                else { pstep_t p = pat_step((int)P(K_PAT), s); vel = p.vel; len = p.len; tone = p.tone; }
                if (!vel) continue;
                int x = 2 + (int)((float)s * cw), w = clampi((int)cw - 1, 1, 5);
                int lift = run && s == cur ? 2 : 0;
                if (tone >= 0 || tone == -2) {                     // one note: a dot at its place in the chord
                    int k = tone == -2 ? arp_tone((uint32_t)s, vc_n > 0 ? vc_n : 3) : tone;
                    int y = 59 - k * 3 - lift;
                    oled_rect(x, y, w, 2, true);
                } else {
                    int h = 2 + vel * 7 / 127, y = 61 - h - lift;
                    if (run) oled_rect(x, y, w, h, true); else oled_frame(x, y, w, h);
                    int tail = (int)((float)len * cw) - w - 1;
                    if (tail > 1) oled_hline_pat(x + w + 1, y + h / 2, tail, 0x55, true);
                }
            }
            if (run) oled_rect(2 + (int)((float)cur * cw), 48, clampi((int)cw - 1, 1, 5), 1, true);
        } else oled_ftext_c(F_TINY, 64, 53, "KNOCK: A CHORD   TILT: VOICING", 1);
        if (rec_on && ((v->frame >> 3) & 1)) oled_pill(F_TINY, 1, 48, "REC", true);
    }
}

COLD static void icon(int x, int y, bool lit)
{
    (void)lit;
    // four white keys, two black ones between C-D and D-E
    oled_frame(x, y, 12, 9);
    oled_line(x + 3, y + 5, x + 3, y + 8, true); oled_line(x + 6, y + 5, x + 6, y + 8, true); oled_line(x + 9, y, x + 9, y + 8, true);
    oled_rect(x + 2, y, 3, 5, true); oled_rect(x + 5, y, 3, 5, true);
}

const layer_t layer_keys = {
    .name = "KEYS", .letter = 'k', .pages = pages, .npages = 2, .params = params, .nparams = K_N,
    .events = true, .init = init, .audio = audio, .tick = tick, .draw = draw, .icon = icon,
    .changed = changed, .clear = clear, .midi_in = midi_in, .state = state, .playing = playing,
};
